## nRF_connect_SDK/west.yml
```yaml
# The west manifest file (west.yml) importing the nRF Connect SDK (NCS).

manifest:
  version: "0.10"

  remotes:
    # nRF Connect SDK GitHub organization.
    # NCS repositories are hosted here.
    - name: ncs
      url-base: https://github.com/tejlmand

  # If not otherwise specified, the projects below should be obtained
  # from the ncs remote.
  defaults:
    remote: ncs

  # "projects" is a list of git repositories which make up the NCS
  # source code.
  projects:

    - name: nrf
      repo-path: fw-nrfconnect-nrf
      revision: 004f28919197ab0de0dcc2b4538568cb3a94c249
      import: true

  self:
    path: multi_manifest_repo/nRF_connect_SDK
```

## vanilla_zephyr/west.yml
```yaml
# The west manifest file importing vanilla Zephyr.

manifest:
  version: "0.10"

  remotes:
    - name: zephyrproject
      url-base: https://github.com/zephyrproject-rtos

  # If not otherwise specified, the projects below should be obtained
  # from the ncs remote.
  defaults:
    remote: zephyrproject

  projects:
    - name: zephyr
      revision: pull/39382/head

  # West-related configuration for the nrf repository.
  self:
    path: multi_manifest_repo/vanilla_zephyr
```
